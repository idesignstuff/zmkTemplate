#include <physical_layouts.dtsi>
/ {
    position_map {
        compatible = "zmk,physical-layout-position-map";

        physical_layout0 {
            physical-layout = <&physical_layout0>;
            positions = <>;
        };
    };
};
