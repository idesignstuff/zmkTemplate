## boards/shields/ndrl/Kconfig.defconfig
```kconfig
if SHIELD_NDRL

# Name must be less than 16 characters long!
config ZMK_KEYBOARD_NAME
    default "Anduril"
config SPI
    default y
CONFIG_ZMK_USB_BOOT
CONFIG_ZMK_EXT_POWER
endif
```

## boards/shields/ndrl/Kconfig.shield
```kconfig
# No whitespace after the comma or in your keyboard name!
config SHIELD_NDRL
    def_bool $(shields_list_contains,ndrl)
```

## config/west.yml
```yaml
manifest:
  remotes:
    - name: zmkfirmware
      url-base: https://github.com/zmkfirmware
    # Additional modules containing boards/shields/custom code can be listed here as well
      - name: cirque-input-module
        url-base: https://github.com/petejohanson
    # See https://docs.zephyrproject.org/3.2.0/develop/west/manifest.html#projects
  projects:
    - name: zmk
      remote: zmkfirmware
      revision: main
      import: app/west.yml
    - name: cirque-input-module
      remote: cirque-input-module
      revision: main
  self:
    path: config
```
